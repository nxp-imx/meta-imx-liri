## conf/layer.conf
```bitbake
# We have a conf and classes directory, add to BBPATH
BBPATH .= ":${LAYERDIR}"

# We have a packages directory, add to BBFILES
BBFILES += "${LAYERDIR}/recipes-*/*/*.bb \
            ${LAYERDIR}/recipes-*/*/*.bbappend"

BBFILE_COLLECTIONS += "meta-imx-liri"
BBFILE_PATTERN_meta-imx-liri := "^${LAYERDIR}"
BBFILE_PRIORITY_meta-imx-liri = "8"

LAYERSERIES_COMPAT_meta-imx-liri ="zeus"

# Let us add layer-specific bbappends which are only applied when that
# layer is included in our configuration
BBFILES += "${@' '.join('${LAYERDIR}/%s/recipes*/*/*.bbappend' % layer \
               for layer in BBFILE_COLLECTIONS.split())}"


BBMASK += "meta-liri/recipes-boot2qt/gypsy/gypsy_%.bbappend"
BBMASK += "meta-liri/recipes-graphics/mesa/mesa_12.0.6.bb"
BBMASK += "meta-liri/recipes/images/lirios-image.bb"
BBMASK += "meta-liri/recipes-qt/qt5/qtwebengine_git.bbappend"

BBMASK += "meta-mortsgna/appends/meta-qt5/qtbase-native_%.bbappend"
BBMASK += "meta-mortsgna/appends/meta-qt5/qtbase_%.bbappend"
BBMASK += "meta-mortsgna/appends/meta-qt5/qtquickcontrols2_%.bbappend"
BBMASK += "meta-mortsgna/appends/meta-qt5/qtwayland_%.bbappend"
BBMASK += "meta-mortsgna/appends/meta-qt5/vlc_%.bbappend"
BBMASK += "meta-mortsgna/appends/oe-core/gstreamer1.0-plugins-bad_%.bbappend"

BBMASK += "meta-qt5-extra/recipes-liri/liri-wayland/liri-wayland_git.bb"

DISTRO_FEATURES_append = " polkit"
```
